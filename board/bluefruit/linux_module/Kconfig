## board/bluefruit/linux_module/Kconfig
```kconfig
if TARGET_AM335X_LINUX_MODULE

config SYS_BOARD
	default "linux_module"

config SYS_VENDOR
	default "bluefruit"

config SYS_SOC
	default "am33xx"

config SYS_CONFIG_NAME
	default "am335x_linux_module"

source "board/ti/common/Kconfig"

endif
```
